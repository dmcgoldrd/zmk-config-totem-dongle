/*
 * Combo at positions 10+11 within 30ms triggers &tog 2 (GAME layer).
 * Then position 0 on GAME is plain &kp A — no HRM.
 *
 * Press pos 10 → press pos 11 within 30ms → release both → press pos 0 → release
 * Expect: A emitted (HID 0x04). No combo key emits a HID event (it's &tog).
 *
 * This is a 2-fer: validates the combo system fires within timeout-ms,
 * and re-confirms the gaming-layer no-HRM property via a different
 * activation path than tog 2 alone.
 */

#include "../behavior_keymap.dtsi"

&kscan {
    events = <
        ZMK_MOCK_PRESS(2,2,10)
        ZMK_MOCK_PRESS(2,3,15)
        ZMK_MOCK_RELEASE(2,3,30)
        ZMK_MOCK_RELEASE(2,2,10)
        ZMK_MOCK_PRESS(0,0,100)
        ZMK_MOCK_RELEASE(0,0,50)
    >;
};
