/*
 * UTIL layer activation + Ghostty new_tab binding.
 *
 * Hold pos 14 (lt 5 ESC) past 250ms tap term → press pos 0 (LC(LS(T)))
 * Expect: LCTRL (0xE0), LSHFT (0xE1), T (0x17) — Ctrl+Shift+T = new_tab
 *         followed by releases in reverse.
 */

#include "../behavior_keymap.dtsi"

&kscan {
    events = <
        ZMK_MOCK_PRESS(3,2,10)
        ZMK_MOCK_PRESS(0,0,300)
        ZMK_MOCK_RELEASE(0,0,50)
        ZMK_MOCK_RELEASE(3,2,30)
    >;
};
