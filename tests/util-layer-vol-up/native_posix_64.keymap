/*
 * UTIL layer + volume-up on thumb position.
 *
 * After moving window-management bindings to the alpha grid, volume controls
 * live on the thumb cluster: position 12 = C_VOL_UP, position 13 = C_VOL_DN,
 * position 14 = C_MUTE (and is also the UTIL-layer activator via &lt 5 ESC).
 *
 * Hold pos 14 (lt 5 ESC) past 250ms tap term → press pos 12 (thumb C_VOL_UP)
 * Expect: VOL_UP emitted on usage_page 0x0C (consumer), HID 0xE9.
 */

#include "../behavior_keymap.dtsi"

&kscan {
    events = <
        ZMK_MOCK_PRESS(3,2,10)
        ZMK_MOCK_PRESS(3,0,300)
        ZMK_MOCK_RELEASE(3,0,50)
        ZMK_MOCK_RELEASE(3,2,30)
    >;
};
