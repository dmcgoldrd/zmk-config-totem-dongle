/*
 * Mod-morph comma_morph with LSHFT held → emits semicolon.
 * Position 1 is plain LSHFT; position 7 is comma_morph.
 *
 * Hold LSHFT → press comma → release comma → release LSHFT
 * Expect: ; emitted (USB HID 0x33).
 */

#include "../behavior_keymap.dtsi"

&kscan {
    events = <
        ZMK_MOCK_PRESS(0,1,10)
        ZMK_MOCK_PRESS(1,3,50)
        ZMK_MOCK_RELEASE(1,3,30)
        ZMK_MOCK_RELEASE(0,1,10)
    >;
};
