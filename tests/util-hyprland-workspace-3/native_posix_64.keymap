/*
 * UTIL + Hyprland workspace 3 direct.
 *
 * Hold pos 14 → press pos 6 (LG(N3)) → release
 * Expect: LGUI (0xE3), N3 (0x20) — Super+3 = workspace 3 on Hyprland/AeroSpace
 */

#include "../behavior_keymap.dtsi"

&kscan {
    events = <
        ZMK_MOCK_PRESS(3,2,10)
        ZMK_MOCK_PRESS(1,2,300)
        ZMK_MOCK_RELEASE(1,2,50)
        ZMK_MOCK_RELEASE(3,2,30)
    >;
};
